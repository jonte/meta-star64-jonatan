## conf/layer.conf
```bitbake
# We have a conf and classes directory, add to BBPATH
BBPATH .= ":${LAYERDIR}"

# We have recipes-* directories, add to BBFILES
BBFILES += "${LAYERDIR}/recipes-*/*/*.bb \
            ${LAYERDIR}/recipes-*/*/*.bbappend"

BBFILE_COLLECTIONS += "meta-star64-jonatan"
BBFILE_PATTERN_meta-star64-jonatan = "^${LAYERDIR}/"
BBFILE_PRIORITY_meta-star64-jonatan = "6"

LAYERDEPENDS_meta-star64-jonatan = "core"
LAYERSERIES_COMPAT_meta-star64-jonatan = "kirkstone"
```
